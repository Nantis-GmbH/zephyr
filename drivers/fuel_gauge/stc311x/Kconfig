## drivers/fuel_gauge/stc311x/Kconfig
```kconfig
# Copyright (c) 2025
# SPDX-License-Identifier: Apache-2.0

config STC311X
	bool "STC311x fuel gauge"
	default y
	depends on DT_HAS_ST_STC311X_ENABLED
	select I2C
	help
	  Enable the STMicroelectronics STC3115/STC3117 fuel gauge driver.
```

## drivers/rtc/Kconfig.rv3029
```kconfig
# Copyright (c) 2026
# SPDX-License-Identifier: Apache-2.0

config RTC_RV3029
	bool "Micro Crystal RV-3029-C2 I2C RTC driver"
	default y
	depends on DT_HAS_MICROCRYSTAL_RV_3029_C2_ENABLED
	select I2C
	help
	  Enable the Micro Crystal RV-3029-C2 I2C RTC driver.
```

## dts/bindings/fuel-gauge/st,stc311x.yaml
```yaml
# Copyright (c) 2025
# SPDX-License-Identifier: Apache-2.0

description: |
  STMicroelectronics STC3115/STC3117 battery fuel gauge.

  The driver configures the mixed-mode gas gauge using the battery design
  capacity, current sense resistor, and internal battery resistance values
  supplied in devicetree.

compatible: "st,stc311x"

include: [i2c-device.yaml, fuel-gauge.yaml]

properties:
  design-capacity:
    type: int
    required: true
    description: Nominal battery capacity in mAh.

  rsense-milliohm:
    type: int
    required: true
    description: Value of the external current sense resistor in milliohm.

  battery-internal-resistance-milliohm:
    type: int
    required: true
    description: Estimated average battery internal resistance in milliohm.
```

## dts/bindings/rtc/microcrystal,rv-3029-c2.yaml
```yaml
# Copyright (c) 2026
# SPDX-License-Identifier: Apache-2.0

description: Micro Crystal RV-3029-C2 RTC

compatible: "microcrystal,rv-3029-c2"

include:
  - name: rtc-device.yaml
  - name: i2c-device.yaml

properties:
  int-gpios:
    type: phandle-array
    description: |
      Optional GPIO connected to the active-low open-drain INT output.

  clkoe-gpios:
    type: phandle-array
    description: |
      Optional GPIO driving the CLKOE input to enable the CLKOUT pin.
```
